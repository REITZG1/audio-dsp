## sdkconfig.defaults
```kconfig
# Target
CONFIG_IDF_TARGET="esp32p4"

# FreeRTOS
CONFIG_FREERTOS_HZ=1000

# Arduino
CONFIG_AUTOSTART_ARDUINO=y
CONFIG_ARDUINO_LOOP_STACK_SIZE=8192

# PSRAM (Waveshare ESP32-P4-WIFI6 has 32MB PSRAM)
CONFIG_SPIRAM=y
CONFIG_SPIRAM_MODE_HEX=y
CONFIG_SPIRAM_SPEED_200M=y

# Flash
CONFIG_ESPTOOLPY_FLASHSIZE_8MB=y



# Compiler
CONFIG_COMPILER_OPTIMIZATION_PERF=y
CONFIG_COMPILER_DISABLE_DEFAULT_ERRORS=y

# WiFi via esp_wifi_remote + esp-hosted (ESP32-C6 co-processor)
CONFIG_ESP_WIFI_REMOTE_LIBRARY_HOSTED=y

# ESP-Hosted SDIO transport
CONFIG_ESP_HOSTED_SDIO_HOST_INTERFACE=y
CONFIG_ESP_HOSTED_SDIO_CLOCK_FREQ_KHZ=40000
CONFIG_ESP_HOSTED_SDIO_BUS_WIDTH=4
CONFIG_ESP_HOSTED_SDIO_TX_Q_SIZE=60
CONFIG_ESP_HOSTED_SDIO_RX_Q_SIZE=60

# Interrupt watchdog off; Task WDT must be on (Arduino calls it unconditionally)
CONFIG_ESP_INT_WDT=n

# NVS
CONFIG_NVS_ENCRYPTION=n

# Log level
CONFIG_LOG_DEFAULT_LEVEL_INFO=y
CONFIG_LOG_MAXIMUM_LEVEL_VERBOSE=y

# Performance: lwIP
CONFIG_LWIP_TCP_SND_BUF_DEFAULT=65534
CONFIG_LWIP_TCP_WND_DEFAULT=65534
CONFIG_LWIP_TCP_RECVMBOX_SIZE=64
CONFIG_LWIP_UDP_RECVMBOX_SIZE=64
CONFIG_LWIP_TCPIP_RECVMBOX_SIZE=64

# Performance: WiFi
CONFIG_WIFI_RMT_TX_BA_WIN=32
CONFIG_WIFI_RMT_RX_BA_WIN=32
CONFIG_WIFI_RMT_STATIC_RX_BUFFER_NUM=32
CONFIG_WIFI_RMT_DYNAMIC_RX_BUFFER_NUM=64
CONFIG_WIFI_RMT_DYNAMIC_TX_BUFFER_NUM=64

# lwIP IRAM optimization
CONFIG_LWIP_IRAM_OPTIMIZATION=y
CONFIG_LWIP_EXTRA_IRAM_OPTIMIZATION=y

# TCP algorithms
CONFIG_LWIP_TCP_SACK_OUT=y
CONFIG_LWIP_TCP_OOSEQ_MAX_PBUFS=8
CONFIG_LWIP_TCP_RTO_TIME=300

# Pin lwIP to core 1 (core 0 handles SDIO/WiFi)
CONFIG_LWIP_TCPIP_TASK_AFFINITY_CPU1=y
CONFIG_LWIP_TCPIP_TASK_STACK_SIZE=4096
CONFIG_LWIP_TCPIP_CORE_LOCKING=y

# HTTP server
CONFIG_HTTPD_MAX_REQ_HDR_LEN=512
CONFIG_HTTPD_MAX_URI_LEN=256
```
